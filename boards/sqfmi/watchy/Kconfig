## boards/sqfmi/watchy/Kconfig
```kconfig
# Copyright (c) 2022 AVSystem Sławomir Wolf Sp.j. (AVSystem)
# SPDX-License-Identifier: Apache-2.0

config HEAP_MEM_POOL_ADD_SIZE_BOARD
	int
	default 4096 if BOARD_WATCHY_ESP32_PROCPU
	default 256 if BOARD_WATCHY_ESP32_APPCPU
```

## boards/sqfmi/watchy/Kconfig.defconfig
```kconfig
if BOARD_WATCHY_ESP32_PROCPU

config GPIO_HOGS_INIT_PRIORITY
	default 70

config MFD_INIT_PRIORITY
	default 70

config REGULATOR_AXP192_AXP2101_INIT_PRIORITY
	default 71

config GPIO_AXP192_INIT_PRIORITY
	default 72

config REGULATOR_FIXED_INIT_PRIORITY
	default 75

endif # BOARD_WATCHY_ESP32_PROCPU
```

## boards/sqfmi/watchy/Kconfig.watchy
```kconfig
config BOARD_WATCHY
	select SOC_ESP32_PICO_D4
	select SOC_ESP32_PROCPU if BOARD_WATCHY_ESP32_PROCPU
	select SOC_ESP32_APPCPU if BOARD_WATCHY_ESP32_APPCPU
```

## boards/sqfmi/watchy/board.yml
```yaml
board:
  name: watchy
  full_name: Watchy
  vendor: sqfmi
  socs:
  - name: esp32
```
